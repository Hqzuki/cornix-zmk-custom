## Kconfig
```kconfig
# SPDX-License-Identifier: MIT
config CORNIX_LED_STATUS
    bool "Shared Cornix LED status"
    default y if SHIELD_CORNIX_INDICATOR || CORNIX_TB_CENTRAL || CORNIX_RIGHT_PERIPHERAL
    depends on ZMK_BLE

config CORNIX_KEYMAP
    bool "Cornix keymap support"
    default y if (BOARD_CORNIX_RIGHT || CORNIX_TB_CENTRAL) && ZMK_BLE

config CORNIX_PAW3222
    bool "PAW3222 three-wire GPIO driver"
    default y if DT_HAS_CORNIX_PAW3222_GPIO_ENABLED
    depends on GPIO && INPUT

config CORNIX_PAW3222_PROBE_ATTEMPTS
    int "Sensor probe attempts (2 s apart) before polling stops"
    depends on CORNIX_PAW3222
    range 1 100
    default 5

config CORNIX_TB_CENTRAL
    bool "XIAO trackball central for both Cornix halves"
    default y if SHIELD_CORNIX_TB_CENTRAL

config CORNIX_RIGHT_PERIPHERAL
    bool "Keep the right Cornix LED role when it is a peripheral"
    default y if SHIELD_CORNIX_TB_PERIPHERAL && BOARD_CORNIX_RIGHT

config CORNIX_AUTO_OS
    bool "Detect Bluetooth host layout automatically"
    default y if CORNIX_KEYMAP && ZMK_SPLIT_ROLE_CENTRAL && !SHIELD_SETTINGS_RESET
    depends on ZMK_BLE && ZMK_SPLIT_ROLE_CENTRAL
    select BT_GATT_AUTHORIZATION_CUSTOM

config CORNIX_AUTO_OS_SETTLE_MS
    int "Wait after new Bluetooth fingerprint evidence (ms)"
    depends on CORNIX_AUTO_OS
    range 500 5000
    default 1000
```

## boards/shields/cornix_tb_central/Kconfig.shield
```kconfig
# SPDX-License-Identifier: MIT
config SHIELD_CORNIX_TB_CENTRAL
    def_bool $(shields_list_contains,cornix_tb_central)
```

## boards/shields/cornix_tb_peripheral/Kconfig.shield
```kconfig
# SPDX-License-Identifier: MIT
config SHIELD_CORNIX_TB_PERIPHERAL
    def_bool $(shields_list_contains,cornix_tb_peripheral)
```

## dts/bindings/input/cornix,paw3222-gpio.yaml
```yaml
# SPDX-License-Identifier: MIT
# Three-wire half-duplex SDIO, with signal roles detected at every boot.
description: Cornix PAW3222 optical sensor with GPIO three-wire transport
compatible: "cornix,paw3222-gpio"
include: base.yaml
properties:
  autodetect-gpios:
    type: phandle-array
    required: true
    description: Exactly four signal GPIOs to permute as SCK, SDIO, NCS and MOTION
  poll-interval-ms:
    type: int
    default: 15
  res-cpi:
    type: int
    default: 1216
    description: Resolution in multiples of 38 CPI, from 608 to 4826
```
