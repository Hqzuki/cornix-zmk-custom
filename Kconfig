## Kconfig
```kconfig
# SPDX-License-Identifier: MIT
config COREX_PAW3222
    bool "CoreX PAW3222 three-wire GPIO driver"
    default y if DT_HAS_COREX_PAW3222_GPIO_ENABLED
    depends on GPIO && INPUT

config COREX_LED_STATUS
    bool "Shared CoreX and Cornix LED status"
    default y if SHIELD_CORNIX_INDICATOR || (BOARD_COREX_RIGHT && ZMK_BLE)
    depends on ZMK_BLE

config COREX_CORON_KEYMAP
    bool "CoronLP keymap support"
    default y if (BOARD_COREX_RIGHT || BOARD_CORNIX_RIGHT) && ZMK_BLE

config CORNIX_AUTO_OS
    bool "Detect Bluetooth host layout automatically"
    default y if COREX_CORON_KEYMAP && ZMK_SPLIT_ROLE_CENTRAL && !SHIELD_SETTINGS_RESET
    depends on ZMK_BLE && ZMK_SPLIT_ROLE_CENTRAL
    select BT_GATT_AUTHORIZATION_CUSTOM

config CORNIX_AUTO_OS_SETTLE_MS
    int "Wait after new Bluetooth fingerprint evidence (ms)"
    depends on CORNIX_AUTO_OS
    range 500 5000
    default 1000
```

## boards/jzf/corex/Kconfig.corex_right
```kconfig
# SPDX-License-Identifier: MIT
config BOARD_COREX_RIGHT
    select SOC_NRF52840_QIAA
    imply RETAINED_MEM
    imply RETENTION
    imply RETENTION_BOOT_MODE
```

## boards/jzf/corex/Kconfig.defconfig
```kconfig
# SPDX-License-Identifier: MIT
if BOARD_COREX_RIGHT
config ZMK_KEYBOARD_NAME
    default "CoreX ZMK"
config ZMK_SPLIT
    default y
config ZMK_SPLIT_ROLE_CENTRAL
    default y
config ZMK_BLE
    default y
config USB_NRFX
    default y if USB
config USB_DEVICE_STACK
    default y if USB
config BT_MAX_CONN
    default 6 if ZMK_BLE
config BT_MAX_PAIRED
    default 6 if ZMK_BLE
config ZMK_SPLIT_BLE_CENTRAL_BATTERY_LEVEL_FETCHING
    default y if ZMK_SPLIT_BLE
config ZMK_SPLIT_BLE_CENTRAL_BATTERY_LEVEL_PROXY
    default y if ZMK_SPLIT_BLE
config ZMK_STUDIO
    default y if !SHIELD_SETTINGS_RESET
endif
```

## boards/jzf/corex/board.yml
```yaml
boards:
  - name: corex_right
    vendor: jzf
    revision:
      format: major.minor.patch
      default: 7.0.0
      revisions:
        - name: 6.0.0
        - name: 7.0.0
```

## boards/jzf/cornix/Kconfig.defconfig
```kconfig
# cornix board configuration

# Copyright (c) 2020 The ZMK Contributors
# SPDX-License-Identifier: MIT

## Stock Cornix left: split peripheral of the CoreX right central
if BOARD_CORNIX_LEFT

config ZMK_SPLIT
	default y

config ZMK_BLE
	default y

config ZMK_SPLIT_ROLE_CENTRAL
    default n

config ZMK_SPLIT_BLE_ROLE_CENTRAL
	default n

config BOARD_CORNIX_CHARGER
    default y

# Add keyboard debouncing
config ZMK_KSCAN_DEBOUNCE_PRESS_MS
    default 3
config ZMK_KSCAN_DEBOUNCE_RELEASE_MS
    default 3

## disable rgb by default
config ZMK_RGB_UNDERGLOW
	default n
config ZMK_RGB_UNDERGLOW_EXT_POWER
	default n

endif # BOARD_CORNIX_LEFT

# Pure Cornix: stock right is the host-facing central.
if BOARD_CORNIX_RIGHT
config ZMK_KEYBOARD_NAME
    default "Cornix ZMK"
config ZMK_SPLIT
    default y
config ZMK_SPLIT_ROLE_CENTRAL
    default y
config ZMK_BLE
    default y
config USB_NRFX
    default y if USB
config USB_DEVICE_STACK
    default y if USB
config BT_MAX_CONN
    default 6 if ZMK_BLE
config BT_MAX_PAIRED
    default 6 if ZMK_BLE
config ZMK_SPLIT_BLE_CENTRAL_BATTERY_LEVEL_FETCHING
    default y if ZMK_SPLIT_BLE
config ZMK_SPLIT_BLE_CENTRAL_BATTERY_LEVEL_PROXY
    default y if ZMK_SPLIT_BLE
config ZMK_STUDIO
    default y if !SHIELD_SETTINGS_RESET
endif
```

## boards/shields/corex_j3/Kconfig.shield
```kconfig
# SPDX-License-Identifier: MIT
config SHIELD_COREX_J3
    def_bool $(shields_list_contains,corex_j3)
```

## boards/shields/corex_j4/Kconfig.shield
```kconfig
# SPDX-License-Identifier: MIT
config SHIELD_COREX_J4
    def_bool $(shields_list_contains,corex_j4)
```

## boards/shields/corex_trackball/Kconfig.shield
```kconfig
# SPDX-License-Identifier: MIT
config SHIELD_COREX_TRACKBALL
    def_bool $(shields_list_contains,corex_trackball)
```

## dts/bindings/behaviors/corex,coron-pan.yaml
```yaml
# SPDX-License-Identifier: MIT
description: Hold the WIN or MAC scroll layer matching the active base layer
compatible: "corex,coron-pan"
include: zero_param.yaml
```

## dts/bindings/behaviors/corex,led-sync.yaml
```yaml
# SPDX-License-Identifier: MIT
description: Internal right-to-left Bluetooth profile and active layer status synchronization
compatible: "corex,led-sync"
include: two_param.yaml
```

## dts/bindings/behaviors/custom,behavior-os-key.yaml
```yaml
# SPDX-License-Identifier: MIT
description: Send a keycode selected by the active WIN or MAC base layer
compatible: "custom,behavior-os-key"
include: zero_param.yaml
properties:
  mac-layer:
    type: int
    required: true
  win-keycode:
    type: int
    required: true
  mac-keycode:
    type: int
    required: true
```

## dts/bindings/input_processors/custom,input-processor-pan-direction.yaml
```yaml
# SPDX-License-Identifier: MIT
description: Reverse horizontal PAN scrolling when the Mac base layer is active
compatible: "custom,input-processor-pan-direction"
include: ip_zero_param.yaml
properties:
  mac-layer:
    type: int
    required: true
```
