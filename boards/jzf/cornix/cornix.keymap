#if defined(CORNIX_STOCK_RIGHT)
/* ZMK resolves the common board keymap name; the editable name is Cornix. */
#include "../../../config/Cornix.keymap"
#else
/* SPDX-License-Identifier: MIT
 * Stock left is a peripheral: the CoreX right central owns all bindings.
 * Keep only a placeholder for board/reset devicetree parsing.
 */
#include <behaviors.dtsi>
/ {
    keymap {
        compatible = "zmk,keymap";
        peripheral {
            bindings = <
&none &none &none &none &none &none &none &none &none &none &none &none
&none &none &none &none &none &none &none &none &none &none &none &none
&none &none &none &none &none &none &none &none &none &none &none &none &none &none
&none &none &none &none &none &none &none &none &none &none &none
            >;
        };
    };
};
#endif
